/* Conformance test for the bit-by-bit CRC-16 in src/crc16.c, compiled against the REAL source.
 *
 * The value is a FILE FORMAT: the firmware validates /sd2snes/igmenu.bin against the crc16 the
 * SNES-side build step (snes/Makefile) stamped into its header, so a one-bit drift silently
 * disarms the in-game shell -- the gate stays 0 and the user gets the single-tab fail-safe.
 *
 * The table-driven form below is the oracle: the two must agree on every input. */
#include <stdio.h>
#include <stdint.h>

uint16_t crc16_update(uint16_t crc, const unsigned char data);   /* the real one, from src/crc16.c */

/* pycrc v0.7.1 table-driven step, reflected, poly 0x8005 (0xa001 reflected). */
static const uint16_t crc_table[256] = {
    0x0000, 0xc0c1, 0xc181, 0x0140, 0xc301, 0x03c0, 0x0280, 0xc241,
    0xc601, 0x06c0, 0x0780, 0xc741, 0x0500, 0xc5c1, 0xc481, 0x0440,
    0xcc01, 0x0cc0, 0x0d80, 0xcd41, 0x0f00, 0xcfc1, 0xce81, 0x0e40,
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    0x8201, 0x42c0, 0x4380, 0x8341, 0x4100, 0x81c1, 0x8081, 0x4040
};

static uint16_t crc16_update_table(uint16_t crc, unsigned char data) {
  return (uint16_t)(crc_table[(crc ^ data) & 0xff] ^ (crc >> 8));
}

static int fails;

static void expect(uint16_t crc, unsigned char data) {
  uint16_t want = crc16_update_table(crc, data);
  uint16_t got  = crc16_update(crc, data);
  if(want != got) {
    if(fails < 20) printf("FAIL crc=%04x data=%02x: want %04x got %04x\n", crc, data, want, got);
    fails++;
  }
}

int main(void) {
  unsigned c, d;

  /* 1. exhaustive over the byte, for realistic seeds and the edges of the 16-bit state */
  static const uint16_t SEEDS[] = { 0x0000, 0xffff, 0x0001, 0x8000, 0x00ff, 0xff00,
                                    0x5555, 0xaaaa, 0x1021, 0xa001, 0x8005, 0x7fff };
  for(unsigned s = 0; s < sizeof(SEEDS)/sizeof(SEEDS[0]); s++)
    for(d = 0; d < 256; d++) expect(SEEDS[s], (unsigned char)d);

  /* 2. exhaustive over the WHOLE state space for a handful of data bytes */
  static const unsigned char BYTES[] = { 0x00, 0x01, 0x7f, 0x80, 0xa5, 0xff };
  for(unsigned b = 0; b < sizeof(BYTES)/sizeof(BYTES[0]); b++)
    for(c = 0; c <= 0xffff; c++) expect((uint16_t)c, BYTES[b]);

  /* 3. 64 KB of pseudo-random data as a message (init 0xffff, final xor 0xffff -- the
     igmenu.bin convention), comparing the running state at every step */
  uint32_t rnd = 0x2b7e1516;
  uint16_t a = 0xffff, b = 0xffff;
  for(unsigned i = 0; i < 65536; i++) {
    rnd = rnd * 1103515245u + 12345u;
    unsigned char byte = (unsigned char)(rnd >> 16);
    a = crc16_update(a, byte);
    b = crc16_update_table(b, byte);
    if(a != b) {
      if(fails < 20) printf("FAIL stream byte %u (%02x): want %04x got %04x\n", i, byte, b, a);
      fails++;
      a = b;   /* resync so one drift does not print 65535 lines */
    }
  }
  printf("stream crc16 = %04x\n", (uint16_t)(a ^ 0xffff));

  /* 4. the canonical CRC-16/ARC check value: "123456789" -> 0xbb3d with init 0, no final xor */
  {
    const char *s = "123456789";
    uint16_t crc = 0;
    while(*s) crc = crc16_update(crc, (unsigned char)*s++);
    if(crc != 0xbb3d) { printf("FAIL check value: want bb3d got %04x\n", crc); fails++; }
  }

  if(fails) { printf("%d MISMATCH(es)\n", fails); return 1; }
  printf("crc16: all cases match the original table\n");
  return 0;
}
