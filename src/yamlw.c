/* sd2snes - YAML sidecar writer shared by cheats and patch metadata. See yamlw.h. */

#include "config.h"
#include "ff.h"
#include "fileops.h"
#include "fpga_spi.h"
#include "uart.h"
#include "yaml.h"
#include "yamlw.h"

FRESULT yaml_open_write(char *path) {
  FPGA_DESELECT();
  path_asset_mkdir(path);
  f_chmod((TCHAR*)path, 0, AM_RDO | AM_HID | AM_SYS);
  f_unlink((TCHAR*)path);

  file_open((uint8_t*)path, FA_WRITE | FA_CREATE_ALWAYS);
  if(file_res) {
    file_open((uint8_t*)path, FA_WRITE | FA_OPEN_ALWAYS);
    if(!file_res) {
      f_lseek(&file_handle, 0);
      f_truncate(&file_handle);
    }
  }
  if(file_res) {
    printf("yaml_open_write: cannot write %s (%d)\n", path, file_res);
  } else {
    f_puts("---\n# Generated by sd2snes\n", &file_handle);
  }
  return file_res;
}

void yaml_put_quoted(FIL *fp, const char *prefix, const char *s) {
  f_puts(prefix, fp);
  yaml_puts_escaped(fp, s);
  f_puts("\"\n", fp);
}
